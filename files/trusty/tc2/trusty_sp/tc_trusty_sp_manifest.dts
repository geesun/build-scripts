/*
 * Copyright (c) 2022, Arm Limited. All rights reserved.
 *
 * SPDX-License-Identifier: BSD-3-Clause
 */
/dts-v1/;

/ {
	compatible = "arm,ffa-manifest-1.0";
	#address-cells = <2>;
	#size-cells = <1>;

	ffa-version = <0x00010000>; /* 31:16 - Major, 15:0 - Minor */
	id = <0x8001>;
	uuid = <0xf025ee40 0x4c30bca2 0x73a14c8c 0xf18a7dc5>;
	messaging-method = <1>; /* Direct Messaging Only */
	exception-level = <2>; /* S-EL1 */
	execution-state = <0>;
	execution-ctx-count = <8>;
	load-address = <0xf901c000>;
	entrypoint-offset = <0x00004000>;
	managed-exit;
};

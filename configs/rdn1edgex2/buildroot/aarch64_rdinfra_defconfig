## configs/rdn1edgex2/buildroot/aarch64_rdinfra_defconfig
```kconfig
# Architecture
BR2_aarch64=y

# Processor
BR2_neoverse_n1=y

# Additional system packages
BR2_PACKAGE_BUSYBOX_SHOW_OTHERS=y
BR2_PACKAGE_PCIUTILS=y
BR2_PACKAGE_DTC=y
BR2_PACKAGE_DTC_PROGRAMS=y
BR2_PACKAGE_LIBEVENT=y
BR2_PACKAGE_BASH=y
BR2_PACKAGE_SCREEN=y
BR2_PACKAGE_VIM=y
BR2_PACKAGE_KVMTOOL=y
BR2_PACKAGE_DMIDECODE=y
BR2_PACKAGE_STRESS_NG=y
BR2_PACKAGE_URANDOM_SCRIPTS=n

# Target filesystem
BR2_TARGET_ROOTFS_CPIO=y
```

## files/buildroot/defconfig
```kconfig
BR2_aarch64=y
BR2_CCACHE=y
BR2_TOOLCHAIN_EXTERNAL=y
BR2_TOOLCHAIN_EXTERNAL_CUSTOM=y
BR2_TOOLCHAIN_EXTERNAL_PATH="../../tools/gcc-arm-11.2-2022.02-x86_64-aarch64-none-linux-gnu/"
BR2_TOOLCHAIN_EXTERNAL_CUSTOM_PREFIX="$(ARCH)-none-linux-gnu"
BR2_TOOLCHAIN_EXTERNAL_GCC_11=y
BR2_TOOLCHAIN_EXTERNAL_HEADERS_4_20=y
BR2_TOOLCHAIN_EXTERNAL_CUSTOM_GLIBC=y
BR2_TOOLCHAIN_EXTERNAL_CXX=y
# BR2_TOOLCHAIN_EXTERNAL_INET_RPC is not set
BR2_ROOTFS_OVERLAY="board/arm/total-compute/rootfs-overlay"
BR2_TARGET_ROOTFS_CPIO=y
BR2_TARGET_ROOTFS_CPIO_GZIP=y
BR2_TARGET_ROOTFS_CPIO_UIMAGE=y
BR2_PACKAGE_UTIL_LINUX=y
BR2_PACKAGE_UTIL_LINUX_BINARIES=y
# BR2_TARGET_ROOTFS_TAR is not set
```

## files/buildroot/fit-image.its
```
/dts-v1/;

/ {
    description = "Total Compute: fitImage";
    #address-cells = <1>;

    images {
        kernel {
            description = "Linux Kernel";
            data = /incbin/("../../output/tmp_build/linux/arch/arm64/boot/Image");
            type = "kernel";
            arch = "arm64";
            os = "linux";
            compression = "none";
            load = <0x80200000>;
            entry = <0x80200000>;
            hash-1 {
                algo = "sha1";
            };
        };
        fdt-1 {
            description = "Flattened Device Tree blob";
            data = /incbin/("../../output/tmp_build/tfa/build/tc/debug/fdts/tc.dtb");
            type = "flat_dt";
            arch = "arm64";
            load = <0x83000000>;
            compression = "none";
            hash-1 {
                algo = "sha1";
            };
        };
        ramdisk {
            description = "ramdisk";
            data = /incbin/("../../output/tmp_build/buildroot/images/rootfs.cpio.gz");
            type = "ramdisk";
            arch = "arm64";
            load = <0x88000000>;
            os = "linux";
            compression = "gzip";
            hash-1 {
                algo = "sha1";
            };
        };
    };
    configurations {
        default = "conf-1";
        conf-1 {
            description = "TC2: fitImage Boot: kernel with FDT blob and ramdisk";
            kernel = "kernel";
            fdt = "fdt-1";
	    ramdisk = "ramdisk";
            hash-1 {
                algo = "sha1";
            };
        };
    };
};
```
